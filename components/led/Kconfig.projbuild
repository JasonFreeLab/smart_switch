## components/led/Kconfig.projbuild
```kconfig
menu "[Project] led"

    config LED_GPIO
        int "LED GPIO"
        default 8
        help
            Select GPIO based on hardware connection.

endmenu
```

## components/switch/Kconfig.projbuild
```kconfig
menu "[Project] seitch"

    config SWITCH_GPIO
        int "SWITCH GPIO"
        default 5
        help
            Select GPIO based on hardware connection.

endmenu
```
